## config/Kconfig.shield
```kconfig
# Copyright (c) 2021 The ZMK Contributors
# SPDX-License-Identifier: MIT

config SHIELD_CP44
    def_bool $(shields_list_contains,cp44)
```

## config/boards/shields/cp44/Kconfig.defconfig
```kconfig
# Copyright (c) 2021 The ZMK Contributors
# SPDX-License-Identifier: MIT

if SHIELD_CP44

config ZMK_KEYBOARD_NAME
    default "s0ngkran keyboard"
endif
```
